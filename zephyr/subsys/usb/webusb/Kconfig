## zephyr/subsys/usb/webusb/Kconfig
```kconfig
# Kconfig - USB class drivers configuration options

#
# Copyright (c) 2016 Wind River Systems, Inc.
#
# Licensed under the Apache License, Version 2.0 (the "License");
# you may not use this file except in compliance with the License.
# You may obtain a copy of the License at
#
#     http://www.apache.org/licenses/LICENSE-2.0
#
# Unless required by applicable law or agreed to in writing, software
# distributed under the License is distributed on an "AS IS" BASIS,
# WITHOUT WARRANTIES OR CONDITIONS OF ANY KIND, either express or implied.
# See the License for the specific language governing permissions and
# limitations under the License.
#

if USB_DEVICE_STACK

config WEBUSB_CDC_ACM
	bool
	prompt "WeBUSB Enabled CDC ACM Device Class Driver"
	default n
	help
	WebUSB Enabled CDC ACM device class driver

config WEBUSB_PORT_NAME
	string "WebUsb Enabled CDC ACM class device driver port name"
	depends on WEBUSB_CDC_ACM
	default "WUART"
	help
	Port name through which WebUSB enabled CDC ACM class device driver is accessed

config SYS_LOG_WEBUSB_CDC_ACM_LEVEL
	int
	prompt "WebUsb Enabled CDC ACM device class driver log level"
	depends on WEBUSB_CDC_ACM
	default 0
	help
	Sets log level for WebUSB CDC ACM device class driver

	Levels are:

	- 0 OFF, do not write

	- 1 ERROR, only write SYS_LOG_ERR

	- 2 WARNING, write SYS_LOG_WRN in adition to previous level

	- 3 INFO, write SYS_LOG_INF in adition to previous levels

	- 4 DEBUG, write SYS_LOG_DBG in adition to previous levels

endif # CONFIG_USB_DEVICE_STACK
```
